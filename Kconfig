## Kconfig
```kconfig
menu "ESP SQLite3（官方 SQLite 移植）"

    # ---------------------------------------------------------------------
    # 功能档位
    # ---------------------------------------------------------------------
    choice ESP_SQLITE3_PROFILE
        prompt "功能档位"
        default ESP_SQLITE3_PROFILE_FULL
        help
            五个档位只是给下面的开关提供默认值，选完后仍可逐项修改。
            以下体积为 ESP32-C5 / IDF 6.1 / `-Os` 实测静态库，不含自测：
            MAX、FULL、STANDARD、MINIMAL、CRUD 分别约
            587KB、570KB、471KB、432KB、368KB。

            所有档位统一定义 SQLITE_OMIT_DEPRECATED 和
            SQLITE_OMIT_SHARED_CACHE，不再提供已废弃 API 与共享缓存。
            被移除的接口清单见 docs/00-功能清单.md。

            MAX      : 在 FULL 基础上再打开 UTF-16、扩展加载、
                       bytecode 虚表、normalize 等所有可选开关，
                       用于测量“非废弃功能上限”，不推荐量产。
            FULL     : WAL + FTS5 + RTREE + STAT4 + DBSTAT + 数学函数，
                       功能最全。
            STANDARD : WAL + RTREE + DBSTAT + 数学函数，去掉 FTS5/STAT4，
                       适合大多数联网设备。
            MINIMAL  : 保留核心 SQL 引擎 + JSON（3.38 起内建），
                       关闭 WAL/RTREE/FTS5/STAT4/DBSTAT/数学函数。
            CRUD     : 只保留最基本的增删改查；额外关闭 JSON、日期函数、
                       EXPLAIN、外键、完整性检查、临时库、授权回调、
                       自动 vacuum、进度回调、trace、get_table、incrblob，
                       以及 WAL/FTS5/RTREE/STAT4/DBSTAT 等可选功能。
                       受 3.54.1 预生成 parser 限制，视图、触发器、ALTER、
                       ATTACH、VACUUM、ANALYZE、virtual table 代码仍保留。

            注意：ESP32-C5 当前分区表 ota_0/ota_1 各 1792KB，主固件已占
            约 1536KB。即使 CRUD 档位链接后也约 1904KB，仍放不下；要在
            主固件中链接 SQLite，需改用 16MB Flash 分区表
            （见 docs/02-架构设计.md 的“Flash 预算”章节）。
        config ESP_SQLITE3_PROFILE_MAX
            bool "MAX（所有可选功能全开）"
        config ESP_SQLITE3_PROFILE_FULL
            bool "FULL（功能最全）"
        config ESP_SQLITE3_PROFILE_STANDARD
            bool "STANDARD（推荐）"
        config ESP_SQLITE3_PROFILE_MINIMAL
            bool "MINIMAL（体积较小）"
        config ESP_SQLITE3_PROFILE_CRUD
            bool "CRUD（仅增删改查，体积最小）"
    endchoice

    # ---------------------------------------------------------------------
    # 核心 SQLite 编译选项
    # ---------------------------------------------------------------------
    config ESP_SQLITE3_THREADSAFE
        bool "线程安全（SQLITE_THREADSAFE=1）"
        default y
        default n if ESP_SQLITE3_PROFILE_CRUD
        help
            开启后使用 FreeRTOS 递归互斥量实现 SQLite 的串行化模式，
            多个任务可以各自打开连接访问同一个数据库。
            关闭可节省约 8KB 代码，但只能单任务使用。

    config ESP_SQLITE3_MEMSTATUS
        bool "统计内存使用（sqlite3_status 可用）"
        default y
        default n if ESP_SQLITE3_PROFILE_CRUD
        help
            关闭后 sqlite3_memory_used()/sqlite3_status() 返回 0，
            可略微降低开销。

    config ESP_SQLITE3_PSRAM_PREFER
        bool "优先从 PSRAM 分配 SQLite 内存"
        depends on SPIRAM
        default y
        help
            开启后 SQLite 的页缓存、排序缓冲、语句对象优先放在 PSRAM，
            内部 RAM 只保留小对象。没有 PSRAM 或分配失败时自动回退。

    config ESP_SQLITE3_PAGE_SIZE
        int "默认页大小（字节）"
        range 512 8192
        default 4096
        help
            Flash 文件系统（SPIFFS/FATFS/LittleFS）建议 4096；
            SD 卡 FAT 可用 4096；极小内存场景可用 1024/512。
            页大小在数据库创建时确定，之后不能随意修改。

    config ESP_SQLITE3_CACHE_KIB
        int "默认页缓存大小（KiB）"
        range 8 1024
        default 64
        help
            SQLITE_DEFAULT_CACHE_SIZE 的绝对值（KiB）。
            每打开一个连接都会占用这么多内存（实际按页分配）。
            联网设备建议 32~128KiB。

    config ESP_SQLITE3_LOOKASIDE
        bool "启用 Lookaside 小对象缓存"
        default y
        default n if ESP_SQLITE3_PROFILE_CRUD
        help
            为每个连接预留少量固定大小的小对象槽位，减少 malloc 次数。
            默认 32 槽 x 256 字节 = 8KiB/连接。关闭可省内存但会变慢。

    config ESP_SQLITE3_TEMP_STORE_MEMORY
        bool "临时表/排序使用内存（SQLITE_TEMP_STORE=3）"
        default y
        help
            开启：临时数据只放内存，不写 Flash（推荐，省擦写、速度快）。
            关闭：临时数据写文件，目录由 ESP_SQLITE3_TEMP_DIR 指定。
            内存不足时，开启本项会导致 SQLITE_FULL/ SQLITE_NOMEM 错误。

    config ESP_SQLITE3_TEMP_DIR
        string "临时文件目录（仅在临时数据写文件时使用）"
        default "/db"
        help
            必须是以 / 开头的挂载点，例如 "/spiffs"、"/sdcard"。

    config ESP_SQLITE3_DEFAULT_DIR
        string "相对路径的默认目录"
        default "/db"
        help
            当应用传入相对文件名（如 "test.db"）时，VFS 会自动拼成
            "<本目录>/test.db"。建议设置为数据库所在挂载点。

    config ESP_SQLITE3_BUSY_TIMEOUT_MS
        int "默认 busy timeout（毫秒）"
        range 0 60000
        default 5000

    config ESP_SQLITE3_FOREIGN_KEYS
        bool "默认开启外键约束"
        default y
        default n if ESP_SQLITE3_PROFILE_CRUD

    config ESP_SQLITE3_SECURE_DELETE
        bool "删除数据时清零（防恢复，增加 Flash 擦写）"
        default n

    choice ESP_SQLITE3_SYNCHRONOUS
        prompt "默认同步级别（PRAGMA synchronous）"
        default ESP_SQLITE3_SYNCHRONOUS_FULL
        config ESP_SQLITE3_SYNCHRONOUS_OFF
            bool "OFF (0) - 最快，掉电可能损坏"
        config ESP_SQLITE3_SYNCHRONOUS_NORMAL
            bool "NORMAL (1) - WAL 下推荐"
        config ESP_SQLITE3_SYNCHRONOUS_FULL
            bool "FULL (2) - 掉电安全（推荐）"
        config ESP_SQLITE3_SYNCHRONOUS_EXTRA
            bool "EXTRA (3) - 最安全，最慢"
    endchoice

    config ESP_SQLITE3_NO_SYNC
        bool "跳过 fsync（SQLITE_NO_SYNC，不推荐）"
        default n
        help
            旧社区版默认就是不同步。除非文件系统本身保证掉电安全，
            否则不要开启，否则掉电可能丢失已提交事务。

    config ESP_SQLITE3_IOCAP_POWERSAFE_OVERWRITE
        bool "声明设备支持幂等覆盖写（SQLITE_IOCAP_POWERSAFE_OVERWRITE）"
        default n
        help
            只有确认底层文件系统在掉电时不会写出“半新半旧”的扇区才可开启。
            SPIFFS/FATFS 一般不保证，保持关闭最安全。

    config ESP_SQLITE3_MAX_EXPR_DEPTH
        int "表达式最大嵌套深度"
        range 0 1000
        default 100

    # ---------------------------------------------------------------------
    # 可选功能
    # ---------------------------------------------------------------------
    config ESP_SQLITE3_ENABLE_WAL
        bool "WAL 日志模式"
        default y if ESP_SQLITE3_PROFILE_MAX || ESP_SQLITE3_PROFILE_FULL || ESP_SQLITE3_PROFILE_STANDARD
        default n
        help
            WAL 读写并发更好、写入更快，但会额外生成 -wal/-shm 文件。
            SPIFFS 上频繁写入仍会磨损 Flash，长期运行建议只读或配合
            定期 checkpoint + VACUUM。

    config ESP_SQLITE3_ENABLE_FTS5
        bool "全文检索 FTS5"
        depends on !ESP_SQLITE3_PROFILE_CRUD
        default y if ESP_SQLITE3_PROFILE_MAX || ESP_SQLITE3_PROFILE_FULL
        default n

    config ESP_SQLITE3_ENABLE_RTREE
        bool "R*Tree 空间索引"
        depends on !ESP_SQLITE3_PROFILE_CRUD
        default y if ESP_SQLITE3_PROFILE_MAX || ESP_SQLITE3_PROFILE_FULL || ESP_SQLITE3_PROFILE_STANDARD
        default n

    config ESP_SQLITE3_ENABLE_STAT4
        bool "STAT4 查询规划器统计"
        default y if ESP_SQLITE3_PROFILE_MAX || ESP_SQLITE3_PROFILE_FULL
        default n
        help
            ANALYZE 后能生成更精确的统计信息，代价是 ANALYZE 变慢、体积变大。

    config ESP_SQLITE3_ENABLE_DBSTAT
        bool "DBSTAT 虚拟表（分析表和索引占用）"
        depends on !ESP_SQLITE3_PROFILE_CRUD
        default y if ESP_SQLITE3_PROFILE_MAX || ESP_SQLITE3_PROFILE_FULL || ESP_SQLITE3_PROFILE_STANDARD
        default n

    config ESP_SQLITE3_ENABLE_MATH
        bool "数学函数（sin/cos/pow/ln 等）"
        default y if ESP_SQLITE3_PROFILE_MAX || ESP_SQLITE3_PROFILE_FULL || ESP_SQLITE3_PROFILE_STANDARD
        default n

    config ESP_SQLITE3_ENABLE_COLUMN_METADATA
        bool "列元数据 API（sqlite3_column_table_name 等）"
        default y
        default n if ESP_SQLITE3_PROFILE_CRUD

    config ESP_SQLITE3_ENABLE_BYTECODE_VTAB
        bool "bytecode 虚拟表（调试用）"
        default y if ESP_SQLITE3_PROFILE_MAX
        default n

    config ESP_SQLITE3_ENABLE_NORMALIZE
        bool "sqlite3_normalized_sql()"
        default y if ESP_SQLITE3_PROFILE_MAX
        default n

    config ESP_SQLITE3_UTF16
        bool "保留 UTF-16 API"
        default y if ESP_SQLITE3_PROFILE_MAX
        default n
        help
            关闭时定义 SQLITE_OMIT_UTF16，可省约 20KB。
            数据库内部始终是 UTF-8，只有需要 sqlite3_bind_text16 等
            UTF-16 接口时才需要开启。

    config ESP_SQLITE3_LOAD_EXTENSION
        bool "动态加载扩展（需要 xDlOpen）"
        default y if ESP_SQLITE3_PROFILE_MAX
        default n
        help
            ESP-IDF 固件没有通用动态库加载器，默认关闭。
            如需使用扩展，请把它们编译进固件并用 sqlite3_auto_extension 注册。

    # 注意：共享缓存与废弃 API 已统一移除，不再提供 Kconfig 开关。

    # ---------------------------------------------------------------------
    # VFS
    # ---------------------------------------------------------------------
    config ESP_SQLITE3_VFS_NAME
        string "VFS 名称"
        default "esp_sqlite3"

    config ESP_SQLITE3_MAX_PATH
        int "最大路径长度"
        range 64 512
        default 128

    config ESP_SQLITE3_SECTOR_SIZE
        int "xSectorSize 返回值"
        range 512 65536
        default 4096
        help
            SQLite 用该值判断原子写边界。Flash 文件系统建议 4096，
            SD 卡可用 512。该值只影响日志同步策略，不影响实际读写块大小。

    config ESP_SQLITE3_LOG_ERRORS
        bool "把 SQLite 内部错误写入 ESP_LOG"
        default y

    # ---------------------------------------------------------------------
    # 自测
    # ---------------------------------------------------------------------
    config ESP_SQLITE3_SELFTEST
        bool "编译内置自测用例（esp_sqlite3_run_selftest）"
        default n
        help
            仅用于 components/esp_sqlite3/test_apps/selftest 工程。
            主固件一般不要打开。

endmenu
```

## test_apps/selftest/sdkconfig.defaults
```kconfig
# 自测工程默认配置
CONFIG_PARTITION_TABLE_CUSTOM=y
CONFIG_PARTITION_TABLE_CUSTOM_FILENAME="partitions.csv"
CONFIG_ESPTOOLPY_FLASHSIZE_4MB=y
CONFIG_COMPILER_OPTIMIZATION_SIZE=y
CONFIG_BOOTLOADER_COMPILER_OPTIMIZATION_SIZE=y
CONFIG_FREERTOS_HZ=1000
CONFIG_LOG_DEFAULT_LEVEL_INFO=y
# SQLite 初始化/自测需要比默认 3584B 更大的主任务栈
CONFIG_ESP_MAIN_TASK_STACK_SIZE=32768

# 默认使用 FULL 档位并打开自测代码
CONFIG_ESP_SQLITE3_PROFILE_FULL=y
CONFIG_ESP_SQLITE3_SELFTEST=y
```

## test_apps/stress/sdkconfig.defaults
```kconfig
# 压力/掉电测试工程默认配置
CONFIG_PARTITION_TABLE_CUSTOM=y
CONFIG_PARTITION_TABLE_CUSTOM_FILENAME="partitions.csv"
CONFIG_ESPTOOLPY_FLASHSIZE_4MB=y
CONFIG_COMPILER_OPTIMIZATION_SIZE=y
CONFIG_BOOTLOADER_COMPILER_OPTIMIZATION_SIZE=y
CONFIG_FREERTOS_HZ=1000
CONFIG_LOG_DEFAULT_LEVEL_INFO=y
CONFIG_ESP_MAIN_TASK_STACK_SIZE=32768

# SQLite 运行配置：FULL 档，提供 WAL/FTS5/RTREE
CONFIG_ESP_SQLITE3_PROFILE_FULL=y
CONFIG_ESP_SQLITE3_CACHE_KIB=8
CONFIG_ESP_SQLITE3_SELFTEST=n
```
